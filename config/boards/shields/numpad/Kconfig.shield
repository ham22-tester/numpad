## config/boards/shields/numpad/dts/bindings/gpio/nxp,pca9555.yaml
```yaml
description: NXP PCA9555 GPIO expander

compatible: "nxp,pca9555"

include:
  - name: i2c-device.yaml
  - name: gpio-controller.yaml

properties:
  reg:
    required: true

  ngpios:
    type: int
    required: true

  gpio-controller:
    type: boolean

  "#gpio-cells":
    const: 2

  interrupt-gpios:
    type: phandle-array
    required: false
```

## config/boards/shields/numpad/dts/bindings/gpio/nxp,pca95xx.yaml
```yaml
description: NXP PCA95xx GPIO expander

compatible: "nxp,pca95xx"

include:
  - name: i2c-device.yaml
  - name: gpio-controller.yaml

properties:
  reg:
    required: true

  ngpios:
    type: int
    required: true

  gpio-controller:
    required: true
   

  "#gpio-cells":
    const: 2

  interrupt-gpios:
    type: phandle-array
    required: false
```
